## config/west.yml
```yaml
manifest:
  remotes:
    - name: keychron
      url-base: https://github.com
  projects:
    - name: zmk
      remote: keychron
      revision: zmk
      import: app/west.yml
  self:
    path: config
```
